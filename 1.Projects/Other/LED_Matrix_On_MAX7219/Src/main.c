#include <stdio.h>
#include "stm32f407xx.h"
#include "../Inc/GPIO_driver.h"
#include "../Inc/MAX7219.h"

MAX7219_Pin MAX7219 = {GPIOA, 4, 5, 7};

const uint8_t characterLib[43][8]={
{0x3C,0x42,0x42,0x42,0x42,0x42,0x42,0x3C},//0 
{0x10,0x18,0x14,0x10,0x10,0x10,0x10,0x10},//1 
{0x7E,0x02,0x02,0x7E,0x40,0x40,0x40,0x7E},//2 
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{0x00,0x7F,0x02,0x04,0x08,0x10,0x20,0x7F},//Z
};

volatile uint32_t ticks;

void delay(volatile uint32_t time)
{
  ticks = time;
  while(ticks !=0);
} 

void SysTick_Handler(void){
	if(ticks !=0)
	{
		ticks --;
	}	
}


void setup()
{
	/* COnfigure MAX7219 pins: PA7 as MOSI, PA4 as CS and PA5 as CLK */
	GPIOInit(GPIOA, 4, OUTPUT, PUSHPULL, HIGHSPEED, NOPULL, NOAF);
	GPIOInit(GPIOA, 5, OUTPUT, PUSHPULL, HIGHSPEED, NOPULL, NOAF);
	GPIOInit(GPIOA, 7, OUTPUT, PUSHPULL, HIGHSPEED, NOPULL, NOAF);	
  delay(500);
  init_MAX7219();
}

void writeChar(uint8_t charC){
	uint8_t i;
	for(i = 1; i < 9; i++)
		write_MAX7219(i, characterLib[charC - '0'][i-1]);
		delay(500);
}

void writeString(uint8_t str[], uint8_t len){
	uint8_t i;
	for(i = 0; i < len; i++){
		writeChar(str[i]);		
	}
}

int main(void) {
	uint8_t str[5] = {'H', 'A', 'P', 'P', 'Y'};	
	
	/* Configure SysTick interrupt every 1ms */
	SysTick_Config(SystemCoreClock/1000);
	
	setup();	
	
	while(1){
		writeString( str, 5);		
	}
}
